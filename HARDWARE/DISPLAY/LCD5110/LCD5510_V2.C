#include <stdio.h>
#include <stdlib.h>
#include "LCD5510_V2.H"
extern unsigned char code Font_code[][6] = {
	{ 0x00,0x00,0x00,0x00,0x00,0x00 },// (0)
	{ 0x00,0x00,0x00,0x4F,0x00,0x00 },//!(1)
	{ 0x00,0x00,0x07,0x00,0x07,0x00 },//"(2)
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	{ 0x00,0x1C,0x22,0x44,0x22,0x1C } };//爱心(132)

										/*--------------------------------------------------------------*/
										//写入一个字节(数据或指令)
										//wbyte:	待写入的数据
										//dat_cmd:	1-数据, 0-指令
void LCD_write_byte(unsigned char wbyte, unsigned char dat_cmd)
{
	unsigned char i;

	LCD_CS = 0;			//使能
	LCD_DC = dat_cmd;	//1-数据	//0-指令

	for (i = 8; i; i--)	//8位数据, 先高后低
	{
		if (wbyte & 0x80) { LCD_DIN = 1; }
		else { LCD_DIN = 0; }

		LCD_CLK = 0;
		wbyte <<= 1;	//移位(延时)
		LCD_CLK = 1;	//上升沿写入
	}

	LCD_CS = 1;			//禁止
}


/*--------------------------------------------------------------*/
//写入n个字节(数据)(ROM)
//*wbyte:	待写入的数据指针
//num:		待写入的数据个数
/*void LCD_write_nbyte(unsigned char code *wbyte, unsigned char num)
{
unsigned char i, j;
unsigned char temp;

LCD_CS = 0;			//使能
LCD_DC = 1;			//数据

for(j = 0; j < num; j++)//num个数据
{
temp = wbyte[j];
for(i = 8; i; i--)	//8位数据, 先高后低
{
if(temp & 0x80) {LCD_DIN = 1;}
else			{LCD_DIN = 0;}

LCD_CLK = 0;
temp <<= 1;		//移位(延时)
LCD_CLK = 1;	//上升沿写入
}
}

LCD_CS = 1;			//禁止
}


/*--------------------------------------------------------------*/
//显示清屏(清DDRAM)
void LCD_clr_scr(void)
{
	unsigned int i;

	LCD_write_cmd(X_Col_Addr);
	LCD_write_cmd(Y_Page_Addr);

	for (i = 504; i; i--) LCD_write_dat(0x00);
}


/*--------------------------------------------------------------*/
//显示清行
//num:	0 - 5
void LCD_clr_row(unsigned char num)
{
	unsigned char i;

	LCD_pos_byte(0, num);
	for (i = 84; i; i--) LCD_write_dat(0x00);
}


/*--------------------------------------------------------------*/
//液晶字节定位(1*1)
//液晶规划:
//x: 0 - 83
//y: 0 - 5
void LCD_pos_byte(unsigned char x, unsigned char y)
{
	x |= X_Col_Addr;
	y |= Y_Page_Addr;
	LCD_write_cmd(x);	//列地址
	LCD_write_cmd(y);	//页地址
}


/*--------------------------------------------------------------*/
//液晶字符输出(6*8字体)
//x: 0 - 13
//y: 0 - 5
void LCD_printc(unsigned char x, unsigned char y, unsigned char c_dat)
{
	unsigned char i;

	c_dat -= 32;		//查表
	x *= 6;				//宽6

	LCD_pos_byte(x, y);	//坐标
	for (i = 0; i < 6; i++) LCD_write_dat(Font_code[c_dat][i]);
}


/*--------------------------------------------------------------*/
//液晶字符串输出(6*8字体)
//x: 0 - 13
//y: 0 - 5
void LCD_prints(unsigned char x, unsigned char y, unsigned char *s_dat)
{
	while (*s_dat && x < 14) { LCD_printc(x++, y, *s_dat); s_dat++; }
}


/*--------------------------------------------------------------*/
//液晶字符串输出,自动换行(6*8字体)
//x: 0 - 13
//y: 0 - 5
void LCD_printsl(unsigned char x, unsigned char y, unsigned char *s_dat)
{
	while (*s_dat)
	{
		LCD_printc(x++, y, *s_dat);
		s_dat++;
		if (x == 14) { x = 0; y++; }
		if (y == 6) { y = 0; }
	}
}
void LCD_printNum_I(u8 x, u8 y, int num,u8 numLength)
{
	u8 *str=malloc(numLength); //根据数字位数动态生成
	sprintf(str, "%d", num);
	LCD_printsl(x, y, str);
	free(str);
}
void LCD_printNum_F(u8 x, u8 y, float num,u8 numLength, u8 accuracy)
{
	u8 *str=malloc(numLength+accuracy+1);
	sprintf(str, "%f", num);
	LCD_printsl(x, y, str);
	free(str);
}

/*--------------------------------------------------------------*/
//复位LCD5510
/*void LCD_reset_5510(void)
{
LCD_clr_scr();				//清全屏

LCD_write_cmd(0x25);		//省电模式, 水平寻址, 扩展指令
LCD_write_cmd(0x04);		//VLCD温度系数0
LCD_write_cmd(0x10);		//设置偏置系统(BSx)
LCD_write_cmd(0xc0);		//设置电压VLCD = 3.06 + 0.06*Vop;

LCD_write_cmd(0x24);		//省电模式, 水平寻址, 常规指令
LCD_write_cmd(0x08);		//显示空白
LCD_write_cmd(Y_Page_Addr);	//起始页地址0
LCD_write_cmd(X_Col_Addr);	//起始列地址0
}


/*--------------------------------------------------------------*/
//初始化LCD5510
void LCD5510_Init(void)
{
	GPIO_InitTypeDef    GPIO_InitStructure;     //设置管脚
	GPIO_InitStructure.Mode = GPIO_PullUp;
	GPIO_InitStructure.Pin = GPIO_Pin_0 || GPIO_Pin_1 || GPIO_Pin_2 || GPIO_Pin_3 || GPIO_Pin_4;    //lcd5110
	GPIO_Inilize(GPIO_P5, &GPIO_InitStructure);
	LCD_reset_hard;				//硬件复位
								//	LCD_reset_soft;				//软件复位

	LCD_write_cmd(0x21);		//工作模式, 水平寻址, 扩展指令
	LCD_write_cmd(0x06);		//VLCD温度系数2
	LCD_write_cmd(0x13);		//设置偏置系统(BSx) 1:48
	LCD_write_cmd(0xc8);		//设置电压VLCD = 3.06 + 0.06*Vop, 对比度调整

	LCD_write_cmd(0x20);		//工作模式, 水平寻址, 常规指令
	LCD_write_cmd(0x0c);		//普通模式
	LCD_write_cmd(Y_Page_Addr);	//起始页地址0
	LCD_write_cmd(X_Col_Addr);	//起始列地址0
	LCD_clr_scr();				//清全屏
}

/*--------------------------------------------------------------*/






